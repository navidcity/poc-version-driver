## Documentation/devicetree/bindings/misc/plc2,poc-git-version-register.yaml
```yaml
# SPDX-License-Identifier: (GPL-2.0-only OR BSD-2-Clause)
%YAML 1.2
---
$id: http://devicetree.org/schemas/misc/plc2,poc-git-version-register.yaml#
$schema: http://devicetree.org/meta-schemas/core.yaml#

title: PoC Version Register IP core

maintainers:
  - Navid Jalali <navidcity@gmail.com>

description: |
  The PoC library's FPGA IP core PoC.axi4lite_GitVersionRegister: a block of
  read-only 32-bit registers on an AXI4-Lite bus that hold build, Git and
  unique-ID metadata fixed when the FPGA design is synthesised. A design may
  contain several instances, each with its own node.

  The compatible carries no IP core version. The register layout is selected
  by the Version-of-Version-Reg, a register at the same offset in every
  layout, so one compatible covers every layout the IP core ships.

properties:
  compatible:
    const: plc2,poc-git-version-register

  reg:
    maxItems: 1

required:
  - compatible
  - reg

additionalProperties: false

examples:
  - |
    bus {
        #address-cells = <1>;
        #size-cells = <1>;

        version@43c00000 {
            compatible = "plc2,poc-git-version-register";
            reg = <0x43c00000 0x1000>;
        };
    };
```

## Kconfig
```kconfig
# SPDX-License-Identifier: GPL-2.0-only
#
# Used only for the in-tree KUnit build ("make kunit"). The out-of-tree
# module build against a kernel tree does not read this file.

config POC_VERSION
	tristate "PoC Version Register IP core"
	depends on HAS_IOMEM
	select REGMAP_MMIO
	help
	  Driver for the PoC library's Version Register IP core
	  (PoC.axi4lite_GitVersionRegister). Each Instance shows its build,
	  Git and unique-ID metadata as read-only sysfs files, grouped by
	  Category, with debugfs files for testing.

	  To compile this driver as a module, choose M here: the module
	  will be called poc-version.

config POC_VERSION_KUNIT_TEST
	bool "KUnit tests for the poc-version driver" if !KUNIT_ALL_TESTS
	depends on POC_VERSION && KUNIT
	depends on KUNIT=y || POC_VERSION=m
	default KUNIT_ALL_TESTS
	help
	  KUnit tests of Value rendering: given the Raw values of an
	  Instance's Registers, they check the exact text of each sysfs
	  Value file. The tests are built into the poc-version driver
	  itself and need no hardware.

	  If unsure, say N.
```
